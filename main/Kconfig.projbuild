## main/Kconfig.projbuild
```kconfig
menu "Swipe Controller configuration"

config HOSTNAME
  string "Host Name"
  default "test"

config WIFI_SSID
  string "WiFi SSID"

config WIFI_PASS
  string "WiFi Password"

config OTA_IP
  string "OTA server IP address"
  default ""

config NTP_SERVER
  string "NTP Server"
  default ""

config HAS_INTERNAL_SENSOR
  bool "Has internal sensor"
  default n

config HAS_EXTERNAL_SENSOR
  bool "Has external sensor"
  default n

choice
  prompt "Internal Sensor Type"
  default USE_SENSOR_BME680
  depends on HAS_INTERNAL_SENSOR

  config USE_SENSOR_BME680
    bool "BME680 Sensor"

  config USE_SENSOR_BME280
    bool "BME280 Sensor"

endchoice

config BACKLIGHT_TIMEOUT
  int "Backlight Timeout (s)"
  default 5
  help
    Automatically turn off the backlight after the specified amount of seconds

endmenu

menu "Hidden computed values"
  visible if n

config HAS_NO_SENSOR
  bool "No sensors in this device"
  default y if !HAS_INTERNAL_SENSOR || !HAS_EXTERNAL_SENSOR


endmenu
```
